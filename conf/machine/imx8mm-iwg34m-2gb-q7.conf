## conf/machine/imx8mm-iwg34m-2gb-q7.conf
```bitbake
#@TYPE: Machine
#@NAME: iWave iW-RainboW-G34M-i.MX8M Mini uQSeven Development Kit
#@SOC: i.MX8MM
#@DESCRIPTION: Machine configuration for iWave iW-RainboW-G34M-i.MX8M Mini uQSeven Development Kit
#@MAINTAINER: iWave Systems Technologies Pvt. Ltd.

require imx8mm-iwg34m-q7.conf

UBOOT_CONFIG_BASENAME = "imx8mm_iwg34m_q7_2gb"

TEE_LOAD_ADDR = "0xbe000000"
CFG_DDR_SIZE = "0x80000000"
```

## conf/machine/imx8mm-iwg34m-2gb.conf
```bitbake
#@TYPE: Machine
#@NAME: iWave iW-RainboW-G34M-i.MX8M Mini SODIMM SOM Development Kit
#@SOC: i.MX8MM
#@DESCRIPTION: Machine configuration for iWave iW-RainboW-G34M-i.MX8M Mini SODIMM SOM Development Kit
#@MAINTAINER: iWave Systems Technologies Pvt. Ltd.

require imx8mm-iwg34m.conf

UBOOT_CONFIG_BASENAME = "imx8mm_iwg34m_2gb"

TEE_LOAD_ADDR = "0xbe000000"
CFG_DDR_SIZE = "0x80000000"
```

## conf/machine/imx8mm-iwg34m-4gb.conf
```bitbake
#@TYPE: Machine
#@NAME: iWave iW-RainboW-G34M-i.MX8M Mini SODIMM SOM Development Kit
#@SOC: i.MX8MM
#@DESCRIPTION: Machine configuration for iWave iW-RainboW-G34S-i.MX8M Mini SODIMM SOM Development Kit
#@MAINTAINER: iWave Systems Technologies Pvt. Ltd.

require imx8mm-iwg34m-2gb.conf

UBOOT_CONFIG_BASENAME = "imx8mm_iwg34m_4gb"
TEE_LOAD_ADDR = "0xbe000000"
CFG_DDR_SIZE = "0x100000000"
```

## conf/machine/imx8mm-iwg34m-q7.conf
```bitbake
#@TYPE: Machine
#@NAME: iWave iW-RainboW-G34M-i.MX8M Mini uQSeven Development Kit
#@SOC: i.MX8MM
#@DESCRIPTION: Machine configuration for iWave iW-RainboW-G34M-i.MX8M Mini uQSeven Development Kit
#@MAINTAINER: iWave Systems Technologies Pvt. Ltd.

require include/imx8mm-iwg.inc

# The device tree name is implicit for LPDDR4, so can't use MACHINE here
KERNEL_DEVICETREE_BASENAME = "imx8mm-iwg34m-q7"

KERNEL_DEVICETREE = " \
        freescale/${KERNEL_DEVICETREE_BASENAME}-prgtd.dtb \
        freescale/${KERNEL_DEVICETREE_BASENAME}-rpmsg-2gb.dtb \
"

KERNEL_DEFCONFIG_NAME = "iw_rainbow_defconfig"
HOSTNAME = "iWave-G34M"

UBOOT_CONFIG_BASENAME = "imx8mm_iwg34m_q7"
TEE_LOAD_ADDR = "0x7e000000"
CFG_DDR_SIZE = "0x40000000"

ROOTFS_VERSION = "iW-PRGNZ-SC-01-R3.0-REL1.0-Yoctokirkstone"

SRCBRANCH-ATF = "lf_v2.6"
SRCREV-ATF = "c6a19b1a351308cc73443283f6aa56b2eff791b8"
SRCBRANCH-MKIMAGE = "lf-5.15.32_2.0.0"
SRCREV-MKIMAGE = "a8bb8edb45492ac70b33734122a57aa8e38a20bd"
SRCBRANCH-OPTEE = "lf-5.15.32_2.0.0"
SRCREV-OPTEE = "984996422c25c99ebfc5194c1bb393028605bb0c"
SRCBRANCH-UBOOT = "lf_v2022.04"
SRCREV-UBOOT = "1c881f4da83cc05bee50f352fa183263d7e2622b"
SRCBRANCH-KERNEL = "lf-5.15.y"
SRCREV-KERNEL = "fa6c3168595c02bd9d5366fcc28c9e7304947a3d"

M4-BINARIES = "file://imx8mm_m4_TCM_hello_world_yz_1gb.bin file://imx8mm_m4_TCM_rpmsg_lite_pingpong_rtos_linux_remote_yz_1gb.bin file://imx8mm_m4_TCM_rpmsg_lite_str_echo_rtos_yz_1gb.bin file://imx8mm_m4_TCM_hello_world_yz_2gb.bin file://imx8mm_m4_TCM_rpmsg_lite_pingpong_rtos_linux_remote_yz_2gb.bin file://imx8mm_m4_TCM_rpmsg_lite_str_echo_rtos_yz_2gb.bin"
```

## conf/machine/imx8mm-iwg34m.conf
```bitbake
#@TYPE: Machine
#@NAME: iWave iW-RainboW-G34M-i.MX8M SODIMM SOM Development Kit
#@SOC: i.MX8MM
#@DESCRIPTION: Machine configuration for iWave iW-RainboW-G34M-i.MX8M Mini SODIMM SOM Development Kit
#@MAINTAINER: iWave Systems Technologies Pvt. Ltd.

require include/imx8mm-iwg.inc

# The device tree name is implicit for LPDDR4, so can't use MACHINE here
KERNEL_DEVICETREE_BASENAME = "imx8mm-iwg34m"

KERNEL_DEVICETREE = " \
        freescale/${KERNEL_DEVICETREE_BASENAME}-prevd.dtb \
	freescale/${KERNEL_DEVICETREE_BASENAME}-rpmsg-2gb.dtb \
	freescale/${KERNEL_DEVICETREE_BASENAME}-prevd-pcie-eth1.dtb \
"

KERNEL_DEFCONFIG_NAME = "iw_rainbow_defconfig"
HOSTNAME = "iWave-G34M"

UBOOT_CONFIG_BASENAME = "imx8mm_iwg34m"
IMAGE_INSTALL:append = "linux-firmware-rtl8168"
TEE_LOAD_ADDR = "0x7e000000"
CFG_DDR_SIZE = "0x40000000"

ROOTFS_VERSION = "iW-PRFYZ-SC-01-R1.0-REL0.1-YoctoHonister"

SRCBRANCH-ATF = "iwg34m_5.15.5_1.0.0_0.1"
SRCREV-ATF = "bf49a6eabced1162372dfeae55b208d0cd5ac278"
SRCBRANCH-MKIMAGE = "iwg34m_5.15.5_1.0.0_0.1"
SRCREV-MKIMAGE = "794e1082734e5f1d52f917b7d58493dc527f6e43"
SRCBRANCH-OPTEE = "iwg34m_5.15.5_1.0.0_0.1"
SRCREV-OPTEE = "90da1a97d12dcd0bdb2967238af2b646abec806f"
SRCBRANCH-UBOOT = "iwg34m_5.15.5_1.0.0_0.1"
SRCREV-UBOOT = "bf971aedb2e45a8ffd15d5c37138c96b9fef105b"
SRCBRANCH-KERNEL = "iwg34m_5.15.5_1.0.0_0.1"
SRCREV-KERNEL = "0ff3817096ed07f7a9a8b1497437a7b733d0caf8"

M4-BINARIES = "file://imx8mm_m4_TCM_hello_world_yz_1gb.bin file://imx8mm_m4_TCM_rpmsg_lite_pingpong_rtos_linux_remote_yz_1gb.bin file://imx8mm_m4_TCM_rpmsg_lite_str_echo_rtos_yz_1gb.bin file://imx8mm_m4_TCM_hello_world_yz_2gb.bin file://imx8mm_m4_TCM_rpmsg_lite_pingpong_rtos_linux_remote_yz_2gb.bin file://imx8mm_m4_TCM_rpmsg_lite_str_echo_rtos_yz_2gb.bin"
```

## conf/machine/imx8mm-iwg34s-2gb.conf
```bitbake
#@TYPE: Machine
#@NAME: iWave iW-RainboW-G34S-i.MX8M Mini SBC Development Kit
#@SOC: i.MX8MM
#@DESCRIPTION: Machine configuration for iWave iW-RainboW-G34S-i.MX8M Mini SBC Development Kit
#@MAINTAINER: iWave Systems Technologies Pvt. Ltd.

require imx8mm-iwg34s.conf

KERNEL_DEVICETREE:remove = "freescale/${KERNEL_DEVICETREE_BASENAME}-rpmsg-1gb.dtb"
KERNEL_DEVICETREE += " \
        freescale/${KERNEL_DEVICETREE_BASENAME}-rpmsg-2gb.dtb \
"
UBOOT_CONFIG_BASENAME = "imx8mm_iwg34s_2gb"
TEE_LOAD_ADDR = "0xbe000000"
CFG_DDR_SIZE = "0x80000000"
```

## conf/machine/imx8mm-iwg34s-8gb.conf
```bitbake
#@TYPE: Machine
#@NAME: iWave iW-RainboW-G34S-i.MX8M Mini SBC Development Kit
#@SOC: i.MX8MM
#@DESCRIPTION: Machine configuration for iWave iW-RainboW-G34S-i.MX8M Mini SBC Development Kit
#@MAINTAINER: iWave Systems Technologies Pvt. Ltd.

require imx8mm-iwg34s-2gb.conf

UBOOT_CONFIG_BASENAME = "imx8mm_iwg34s_8gb"
TEE_LOAD_ADDR = "0xbe000000"
CFG_DDR_SIZE = "0x200000000"
```

## conf/machine/imx8mm-iwg34s.conf
```bitbake
#@TYPE: Machine
#@NAME: iWave iW-RainboW-G34S-i.MX8M Mini SBC Development Kit
#@SOC: i.MX8MM
#@DESCRIPTION: Machine configuration for iWave iW-RainboW-G34S-i.MX8M Mini SBC Development Kit
#@MAINTAINER: iWave Systems Technologies Pvt. Ltd.

require include/imx8mm-iwg.inc

# The device tree name is implicit for LPDDR4, so can't use MACHINE here
KERNEL_DEVICETREE_BASENAME = "imx8mm-iwg34s"

KERNEL_DEVICETREE = " \
        freescale/${KERNEL_DEVICETREE_BASENAME}.dtb \
        freescale/${KERNEL_DEVICETREE_BASENAME}-rpi-display.dtb \
	freescale/${KERNEL_DEVICETREE_BASENAME}-gnss.dtb \
	freescale/${KERNEL_DEVICETREE_BASENAME}-rpmsg-1gb.dtb \
"

#Add display configuration
DEFAULT_DISPLAY ??= "HDMI"
DEFAULT_DISPLAY[HDMI] = "LT8912-Bridge"
DEFAULT_DISPLAY[2-lane-display] = "2-lane-display"

UBOOT_CONFIG_BASENAME = "imx8mm_iwg34s"
IMAGE_INSTALL:append = " linux-firmware-rtl8168 "
KERNEL_DEFCONFIG_NAME = "iw_rainbow_defconfig"
HOSTNAME = "iWave-G34S"

TEE_LOAD_ADDR = "0x7e000000"
CFG_DDR_SIZE = "0x40000000"

ROOTFS_VERSION = "iW-PRGII-SC-01-R1.0-REL1.0-YoctoHonister"

SRCBRANCH-ATF = "iwg34s_sr_ir_5.15.5"
SRCREV-ATF = "d47f752620622c96ddef00009549b07daf56e653"
SRCBRANCH-MKIMAGE = "iwg34s_sr_ir_5.15.5"
SRCREV-MKIMAGE = "edb6abf67f91a37524addae8fa88784ba1229959"
SRCBRANCH-OPTEE = "iwg34s_sr_ir_5.15.5"
SRCREV-OPTEE = "c3802c04261347c8133ce126a874ffec5f12f978"
SRCBRANCH-UBOOT = "iwg34s_sr_ir_5.15.5"
SRCREV-UBOOT = "7620162f4c2b54881250ef944976205018786a2f"
SRCBRANCH-KERNEL = "iwg34s_sr_ir_5.15.5"
SRCREV-KERNEL = "88e32bb38419ff980a768f781d1e042fe22496f4"

M4-BINARIES = "file://imx8mm_m4_TCM_hello_world_1gb.bin file://imx8mm_m4_TCM_rpmsg_lite_pingpong_rtos_linux_remote_1gb.bin file://imx8mm_m4_TCM_rpmsg_lite_str_echo_rtos_1gb.bin file://imx8mm_m4_TCM_hello_world_2gb.bin file://imx8mm_m4_TCM_rpmsg_lite_pingpong_rtos_linux_remote_2gb.bin file://imx8mm_m4_TCM_rpmsg_lite_str_echo_rtos_2gb.bin"
```

## conf/machine/imx8mn-iwg37m-2gb-q7.conf
```bitbake
#@TYPE: Machine
#@NAME: iWave iW-RainboW-G37M-i.MX8M Nano uQseven Development Kit
#@SOC: i.MX8MN
#@DESCRIPTION: Machine configuration for iWave iW-RainboW-G37M-i.MX8M Nano uQseven Development Kit
#@MAINTAINER: iWave Systems Technologies Pvt. Ltd.

require imx8mn-iwg37m-q7.conf

UBOOT_CONFIG_BASENAME = "imx8mn_iwg37m_q7_2gb"

CFG_DDR_SIZE = "0x80000000"
```

## conf/machine/imx8mn-iwg37m-2gb.conf
```bitbake
#@TYPE: Machine
#@NAME: iWave iW-RainboW-G37M-i.MX8M Nano SODIMM SOM Development Kit
#@SOC: i.MX8MN
#@DESCRIPTION: Machine configuration for iWave iW-RainboW-G37M-i.MX8M Nano SODIMM SOM Development Kit
#@MAINTAINER: iWave Systems Technologies Pvt. Ltd.

require imx8mn-iwg37m.conf

UBOOT_CONFIG_BASENAME = "imx8mn_iwg37m_2gb"

CFG_DDR_SIZE = "0x80000000"
```

## conf/machine/imx8mn-iwg37m-q7.conf
```bitbake
#@TYPE: Machine
#@NAME: iWave iW-RainboW-G37M-i.MX8M Nano uQseven Development Kit
#@SOC: i.MX8MN
#@DESCRIPTION: Machine configuration for iWave iW-RainboW-G37M-i.MX8M Nano uQseven Development Kit
#@MAINTAINER: iWave Systems Technologies Pvt. Ltd.

require include/imx8mn-iwg.inc

# The device tree name is implicit for LPDDR4, so can't use MACHINE here
KERNEL_DEVICETREE_BASENAME = "imx8mn-iwg37m_q7"
KERNEL_DEVICETREE = " \
        freescale/${KERNEL_DEVICETREE_BASENAME}-prgtd.dtb \
        freescale/${KERNEL_DEVICETREE_BASENAME}-rpmsg-2gb.dtb \
"

KERNEL_DEFCONFIG_NAME = "iw_rainbow_defconfig"
HOSTNAME = "iWave-G37M"

UBOOT_CONFIG_BASENAME = "imx8mn_iwg37m_q7"
CFG_DDR_SIZE = "0x40000000"

ROOTFS_VERSION = "iW-PRGNZ-SC-01-R3.0-REL1.0-YoctoKirkstone"

SRCBRANCH-ATF = "lf_v2.6"
SRCREV-ATF = "c6a19b1a351308cc73443283f6aa56b2eff791b8"
SRCBRANCH-MKIMAGE = "lf-5.15.32_2.0.0"
SRCREV-MKIMAGE = "a8bb8edb45492ac70b33734122a57aa8e38a20bd"
SRCBRANCH-OPTEE = "lf-5.15.32_2.0.0"
SRCREV-OPTEE = "984996422c25c99ebfc5194c1bb393028605bb0c"
SRCBRANCH-UBOOT = "lf_v2022.04"
SRCREV-UBOOT = "1c881f4da83cc05bee50f352fa183263d7e2622b"
SRCBRANCH-KERNEL = "lf-5.15.y"
SRCREV-KERNEL = "fa6c3168595c02bd9d5366fcc28c9e7304947a3d"

M7-BINARIES = "file://imx8mn_m7_TCM_hello_world_jz_1gb.bin file://imx8mn_m7_TCM_rpmsg_lite_pingpong_rtos_linux_remote_jz_1gb.bin file://imx8mn_m7_TCM_rpmsg_lite_str_echo_rtos_jz_1gb.bin file://imx8mn_m7_TCM_hello_world_jz_2gb.bin file://imx8mn_m7_TCM_rpmsg_lite_pingpong_rtos_linux_remote_jz_2gb.bin file://imx8mn_m7_TCM_rpmsg_lite_str_echo_rtos_jz_2gb.bin"
```

## conf/machine/imx8mn-iwg37s-2gb.conf
```bitbake
#@TYPE: Machine
#@NAME: iWave iW-RainboW-G37S-i.MX8M Nano SBC Development Kit
#@SOC: i.MX8MN
#@DESCRIPTION: Machine configuration for iWave iW-RainboW-G37S-i.MX8M Nano SBC Development Kit
#@MAINTAINER: iWave Systems Technologies Pvt. Ltd.

require imx8mn-iwg37s.conf

KERNEL_DEVICETREE_remove = "freescale/${KERNEL_DEVICETREE_BASENAME}-rpmsg-1gb.dtb"
KERNEL_DEVICETREE += " \
        freescale/${KERNEL_DEVICETREE_BASENAME}-rpmsg-2gb.dtb \
"
UBOOT_CONFIG_BASENAME = "imx8mn_iwg37s_2gb"
CFG_DDR_SIZE = "0x80000000"
```

## conf/machine/imx8mn-iwg37s.conf
```bitbake
#@TYPE: Machine
#@NAME: iWave iW-RainboW-G37S-i.MX8M Nano SBC Development Kit
#@SOC: i.MX8MN
#@DESCRIPTION: Machine configuration for iWave iW-RainboW-G37S-i.MX8M Nano SBC Development Kit
#@MAINTAINER: iWave Systems Technologies Pvt. Ltd.

require include/imx8mn-iwg.inc

# The device tree name is implicit for LPDDR4, so can't use MACHINE here
KERNEL_DEVICETREE_BASENAME = "imx8mn-iwg37s"
KERNEL_DEVICETREE = " \
        freescale/${KERNEL_DEVICETREE_BASENAME}.dtb \
        freescale/${KERNEL_DEVICETREE_BASENAME}-rpi-display.dtb \
	freescale/${KERNEL_DEVICETREE_BASENAME}-gnss.dtb \
	freescale/${KERNEL_DEVICETREE_BASENAME}-rpmsg-1gb.dtb \
"

#Add display configuration
DEFAULT_DISPLAY ??= "HDMI"
DEFAULT_DISPLAY[HDMI] = "LT8912-Bridge"
DEFAULT_DISPLAY[2-lane-display] = "2-lane-display"

KERNEL_DEFCONFIG_NAME = "iw_rainbowg37s_defconfig"
HOSTNAME = "iWave-G37S"

UBOOT_CONFIG_BASENAME = "imx8mn_iwg37s"
CFG_DDR_SIZE = "0x40000000"

ROOTFS_VERSION = "iW-PRGII-SC-01-R1.0-REL1.0-YoctoHardknott"

SRCBRANCH-ATF = "iwg34s_5.10.72_2.2.0_1.0"
SRCREV-ATF = "1ae969763d3f3cc85ca86f435d4248e16332ff1e"
SRCBRANCH-MKIMAGE = "iwg34s_5.10.72_2.2.0_1.0"
SRCREV-MKIMAGE = "615c42655634ac52bd5c1a361ed2008b1d4825b7"
SRCBRANCH-OPTEE = "iwg34s_5.10.72_2.2.0_1.0"
SRCREV-OPTEE = "5cfd63d827251f22acc3c14108e3a2457e828e7e"
SRCBRANCH-UBOOT = "iwg34s_5.10.72_2.2.0_1.0"
SRCREV-UBOOT = "d0c6bab39bac732ea35398ca6092a1b6f903d83c"
SRCBRANCH-KERNEL = "iwg34s_5.10.72_2.2.0_1.0"
SRCREV-KERNEL = "89403eb226d942cd59710749f31c4a92af3d6064"

M7-BINARIES = "file://imx8mn_m7_TCM_hello_world_1gb.bin file://imx8mn_m7_TCM_rpmsg_lite_pingpong_rtos_linux_remote_1gb.bin file://imx8mn_m7_TCM_rpmsg_lite_str_echo_rtos_1gb.bin file://imx8mn_m7_TCM_hello_world_2gb.bin file://imx8mn_m7_TCM_rpmsg_lite_pingpong_rtos_linux_remote_2gb.bin file://imx8mn_m7_TCM_rpmsg_lite_str_echo_rtos_2gb.bin"
```

## conf/machine/imx8mp-iwg40m-8gb.conf
```bitbake
#@TYPE: Machine
#@NAME: NXP i.MX8MP Evaluation Kit and i.MX8MP Evaluation Kit
#@SOC: i.MX8MP
#@DESCRIPTION: Machine configuration for NXP i.MX8MP EVK
#@MAINTAINER: Alexandru Palalau <ioan-alexandru.palalau@nxp.com>

MACHINEOVERRIDES =. "mx8:mx8m:mx8mp:"

require conf/machine/include/imx-base.inc
require conf/machine/include/tune-cortexa53.inc

MACHINE_FEATURES += " pci wifi bluetooth optee qca9377 bcm43455 bcm4356 bcm4359"

PREFERRED_PROVIDER_virtual/bootloader_mx8 = "u-boot-iwg40m"
PREFERRED_PROVIDER_virtual/kernel_mx8 = "linux-iwg40m"

KERNEL_DEVICETREE = " \
                     freescale/imx8mp-iwg40d.dtb \
"
UBOOT_CONFIG ??= "sd"
UBOOT_CONFIG[sd] = "imx8mp_iwg40m_8gb_defconfig,sdcard"
SPL_BINARY = "spl/u-boot-spl.bin"

# Set DDR FIRMWARE
DDR_FIRMWARE_NAME = "lpddr4_pmu_train_1d_dmem_202006.bin lpddr4_pmu_train_1d_imem_202006.bin lpddr4_pmu_train_2d_dmem_202006.bin lpddr4_pmu_train_2d_imem_202006.bin"

# Set u-boot DTB
UBOOT_DTB_NAME = "imx8mp-iwg40m.dtb"

IMAGE_INSTALL_append = " iwtest obexftp dhcpcd dnsmasq "

# Set imx-mkimage boot target
IMXBOOT_TARGETS = "flash_iwg40m"

# Set Serial console
SERIAL_CONSOLES = "115200;ttymxc3"

IMAGE_BOOTLOADER = "imx-boot"

LOADADDR = ""
UBOOT_SUFFIX = "bin"
UBOOT_MAKE_TARGET = ""
IMX_BOOT_SEEK = "32"

OPTEE_BIN_EXT = "8mp"

# Add additional firmware
MACHINE_FIRMWARE_append = " linux-firmware-ath10k"
```

## conf/machine/include/imx8m-iwg-common.inc
```bitbake
require conf/machine/include/imx-base.inc
require conf/machine/include/arm/armv8a/tune-cortexa53.inc 

#MACHINE_FEATURES_append_use-nxp-bsp = " optee bcm4359 "

IMX_DEFAULT_BSP = "nxp"
UBOOT_DTB_NAME = "${KERNEL_DEVICETREE_BASENAME}.dtb"

IMX_DEFAULT_BOOTLOADER_use-nxp-bsp = "u-boot-imx"
IMX_DEFAULT_BOOTLOADER_use-mainline-bsp = "u-boot-fslc"

UBOOT_SUFFIX = "bin"

UBOOT_CONFIG ??= "sd"
UBOOT_CONFIG[sd]      = "${UBOOT_CONFIG_BASENAME}_defconfig,sdcard"
UBOOT_CONFIG[mfgtool] = "${UBOOT_CONFIG_BASENAME}_defconfig"

SPL_BINARY = "spl/u-boot-spl.bin"

DDR_FIRMWARE_NAME = "\
	lpddr4_pmu_train_1d_imem.bin \
	lpddr4_pmu_train_1d_dmem.bin \
	lpddr4_pmu_train_2d_imem.bin \
	lpddr4_pmu_train_2d_dmem.bin \
"

IMAGE_INSTALL:append = " iwtest dnsmasq glibc-gconv-utf-16 "

# Extra firmware package name, that is required to build boot container for fslc bsp
IMX_EXTRA_FIRMWARE = "firmware-imx-8m"

IMXBOOT_TARGETS_BASENAME = "flash_iwg"
IMXBOOT_TARGETS = "${@bb.utils.contains('UBOOT_CONFIG', 'fspi', '${IMXBOOT_TARGETS_BASENAME}_flexspi', '${IMXBOOT_TARGETS_BASENAME}', d)}"

IMX_BOOT_UART_BASE = "0x30a60000"
SERIAL_CONSOLES = "115200;ttymxc3"

LOADADDR = ""
UBOOT_SUFFIX = "bin"
UBOOT_MAKE_TARGET = "all"

PREFERRED_PROVIDER_virtual/kernel:${MACHINE} = "linux-iwg"
PREFERRED_PROVIDER_virtual/bootloader:${MACHINE} = "u-boot-iwg"
PREFERRED_PROVIDER_u-boot:${MACHINE} = "u-boot-iwg"
```

## conf/machine/include/imx8mm-iwg.inc
```bitbake
MACHINEOVERRIDES =. "imx-boot-container:mx8:mx8m:mx8mm:"

require imx8m-iwg-common.inc

MACHINE_FEATURES += "pci wifi bluetooth bcm43455 bcm4356 optee bcm4359"

ATF_PLATFORM = "imx8mm"
ATF_LOAD_ADDR = "0x920000"

IMX_BOOT_SOC_TARGET = "iMX8MM"

IMX_BOOT_SEEK = "33"

OPTEE_BIN_EXT = "8mm"
```
